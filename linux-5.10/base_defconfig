## linux-6.6/base_defconfig
```kconfig
#
# General setup
#
CONFIG_FUTEX=y
CONFIG_EPOLL=y
CONFIG_EVENTFD=y
# end of General setup

CONFIG_ARM64_PTR_AUTH=y
CONFIG_INIT_STACK_ALL_ZERO=y
CONFIG_INIT_ON_ALLOC_DEFAULT_ON=y
CONFIG_HARDENED_USERCOPY=y
CONFIG_RANDOMIZE_BASE=y
CONFIG_ARM64_PAN=y
CONFIG_CFI_CLANG=y
CONFIG_HAVE_ARCH_SECCOMP=y
CONFIG_HAVE_ARCH_SECCOMP_FILTER=y
CONFIG_SECURITY_XPM=y
CONFIG_SECCOMP=y
CONFIG_SECCOMP_FILTER=y

CONFIG_MMU=y

#
# General architecture-dependent options
#
CONFIG_ARCH_HAS_FORTIFY_SOURCE=y
CONFIG_STACKPROTECTOR=y
CONFIG_STACKPROTECTOR_STRONG=y
CONFIG_ARCH_HAS_ELF_RANDOMIZE=y
# end of General architecture-dependent options

CONFIG_BLOCK=y
CONFIG_NET=y

#
# Networking options
#
CONFIG_PACKET=y
CONFIG_INET=y
CONFIG_NETFILTER=y
# end of Networking options


#
# Device Drivers
#
#
# Input device support
#
CONFIG_INPUT=y
# end of Input device support
CONFIG_RTC_CLASS=y
#
# RTC interfaces
#
#
# HDF
#
CONFIG_DRIVERS_HDF=y
CONFIG_DRIVERS_HDF_PLATFORM=y
CONFIG_DRIVERS_HDF_PLATFORM_GPIO=y
CONFIG_DRIVERS_HDF_PLATFORM_I2C=y
CONFIG_DRIVERS_HDF_PLATFORM_PWM=y
CONFIG_DRIVERS_HDF_PLATFORM_UART=y
CONFIG_DRIVERS_HDF_PLATFORM_SPI=y
CONFIG_DRIVERS_HDF_INPUT=y
# end of HDF
# end of Device Drivers

#
# File systems
#
CONFIG_HMDFS_FS=y
CONFIG_HMDFS_FS_PERMISSION=y
CONFIG_FILE_LOCKING=y
#
# Pseudo filesystems
#
CONFIG_PROC_FS=y
# end of Pseudo filesystems
# end of File systems

#
# Security options
#
CONFIG_SECURITY=y
# end of Security options

#
#Security DMESG restrict
#
CONFIG_SECURITY_DMESG_RESTRICT=y
# end of Security DMESG restrict

#Enhance SELinux's control over insmod
#
CONFIG_MODULE_SIG=y
CONFIG_MODULE_SIG_FORCE=y
#end of Enhance SELinux's control over insmod
```
