## linux-6.6/hispark_aifly/arch/support_defconfig
```kconfig
#
# begin of support Linux 6.6 upgrade compilation and adaptation
#
CONFIG_SECURITY_CODE_SIGN=y
CONFIG_FS_VERITY=y

CONFIG_SECURITY_XPM=y

CONFIG_AUDIT=y
CONFIG_AUDITSYSCALL=y
CONFIG_NETWORK_SECMARK=y
CONFIG_SECURITY=y
CONFIG_SECURITY_NETWORK=y
CONFIG_LSM_MMAP_MIN_ADDR=65536
CONFIG_SECURITY_SELINUX=y
CONFIG_SECURITY_SELINUX_DEVELOP=n
CONFIG_SECURITY_SELINUX_AVC_STATS=y
CONFIG_SECURITY_SELINUX_SIDTAB_HASH_BITS=9
CONFIG_SECURITY_SELINUX_SID2STR_CACHE_SIZE=256
CONFIG_INTEGRITY_AUDIT=y
CONFIG_AUDIT_GENERIC=y

CONFIG_PWM=y
CONFIG_PWM_SYSFS=y
#
# end of support Linux 6.6 upgrade compilation and adaptation
#

#
# begin of support OH DFX
#
CONFIG_STAGING=y
CONFIG_HILOG=y
CONFIG_HILOG_BUFFER_SIZE=4096
CONFIG_HIEVENT=y
CONFIG_BBOX_BUFFER_SIZE=2048

CONFIG_ANDROID_BINDER_IPC=y
#
# end of support OH DFX
#

#
# begin of support peripherals such as HDF HID MOUSE
#
CONFIG_INPUT_MOUSEDEV=y
CONFIG_INPUT_MOUSEDEV_SCREEN_X=1024
CONFIG_INPUT_MOUSEDEV_SCREEN_Y=768

CONFIG_INPUT_MOUSE=y
CONFIG_MOUSE_PS2=y
CONFIG_MOUSE_PS2_ALPS=y
CONFIG_MOUSE_PS2_BYD=y
CONFIG_MOUSE_PS2_LOGIPS2PP=y
CONFIG_MOUSE_PS2_SYNAPTICS=y
CONFIG_MOUSE_PS2_SYNAPTICS_SMBUS=y
CONFIG_MOUSE_PS2_CYPRESS=y
CONFIG_MOUSE_PS2_TRACKPOINT=y
CONFIG_MOUSE_PS2_FOCALTECH=y
CONFIG_MOUSE_PS2_SMBUS=y

CONFIG_USB_HID=y

CONFIG_HID_SUPPORT=y
CONFIG_HID=y
CONFIG_HID_GENERIC=y

CONFIG_DRIVERS_HDF=y
CONFIG_DRIVERS_HDF_INPUT=y
CONFIG_HDF_SUPPORT_LEVEL=2
#
# end of Support peripherals such as HDF HID MOUSE
#

#
# begin of restore small_defconfig
#
CONFIG_CGROUPS=y
CONFIG_SCHED_MM_CID=y
CONFIG_ARCH_SUPPORTS_KEXEC=y

CONFIG_SUSPEND=y
CONFIG_SUSPEND_FREEZER=y
CONFIG_PM_SLEEP=y
CONFIG_PM_SLEEP_SMP=y

CONFIG_CPU_PM=y
CONFIG_ARCH_HIBERNATION_POSSIBLE=y

CONFIG_FREEZER=y

CONFIG_PREVENT_FIRMWARE_BUILD=y
CONFIG_FW_CACHE=y
CONFIG_VT_CONSOLE_SLEEP=y

CONFIG_WATCHDOG=y
CONFIG_WATCHDOG_HANDLE_BOOT_ENABLED=y
CONFIG_WATCHDOG_OPEN_TIMEOUT=0
#
# end of begin of restore small_defconfig
#

#
# begin of rkh small_defconfig
#
CONFIG_INPUT_KEYBOARD=y
CONFIG_KEYBOARD_ATKBD=y
CONFIG_KEYBOARD_GPIO=y

CONFIG_USB_DWC3=y
CONFIG_USB_DWC3_DUAL_ROLE=y
CONFIG_USB_DWC3_OF_SIMPLE=y

CONFIG_USB_F_FS=y
CONFIG_USB_CONFIGFS_F_FS=y

CONFIG_WING_UPS_MISSILE_PHY=y

CONFIG_SOUND=y
CONFIG_SND=y
CONFIG_SND_USB=y
CONFIG_SND_USB_AUDIO=y
CONFIG_SND_PCM=y
CONFIG_SND_HWDEP=y
CONFIG_SND_TIMER=y

CONFIG_VIDEO_NOMODESET=y
CONFIG_DRM=y
CONFIG_DRM_KMS_HELPER=m
# CONFIG_DRM_FBDEV_EMULATION is not set
CONFIG_DRM_DISPLAY_HELPER=m
# CONFIG_DRM_DISPLAY_DP_HELPER is not set
CONFIG_DRM_DISPLAY_HDCP_HELPER=y
CONFIG_DRM_DISPLAY_HDMI_HELPER=y
CONFIG_DRM_GEM_DMA_HELPER=m

CONFIG_DRM_PANEL=y
CONFIG_DRM_BRIDGE=y
CONFIG_DRM_PANEL_BRIDGE=y
CONFIG_DRM_HISI_SMART_VISION=m
CONFIG_DRM_PANEL_ORIENTATION_QUIRKS=y

CONFIG_HDMI=y
CONFIG_VGA_CONSOLE=y

CONFIG_CMA_SIZE_MBYTES=32

CONFIG_CFG80211=y
CONFIG_MAC80211=y
CONFIG_CFG80211_WEXT=y
CONFIG_WEXT_PRIV=y
CONFIG_BT=y
CONFIG_BT_BREDR=y
CONFIG_BT_LE=y
CONFIG_BT_DEBUGFS=y

CONFIG_DEBUG_FS=y
#
# end of begin of rkh small_defconfig
#

#
# begin of ebaina small_defconfig
#
CONFIG_INPUT_TOUCHSCREEN=y
CONFIG_TOUCHSCREEN_GOODIX=y
CONFIG_DRIVERS_HDF_TP_5P5_GT911=y
CONFIG_DRIVERS_HDF_PLATFORM_MIPI_DSI=y
CONFIG_DRIVERS_HDF_LCDKIT=y
#
# end of begin of ebaina small_defconfig
#

#
# begin of support NCA9555
#
CONFIG_GPIO_NCA9555=y
CONFIG_MFD_NCA9555=y
#
# end of support NCA9555
#
```
